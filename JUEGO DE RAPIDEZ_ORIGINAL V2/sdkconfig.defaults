## JUEGO DE RAPIDEZ_ORIGINAL V2/sdkconfig.defaults
```kconfig
CONFIG_ESPTOOLPY_MONITOR_BAUD=115200
CONFIG_PARTITION_TABLE_SINGLE_APP=y
CONFIG_PARTITION_TABLE_CUSTOM_FILENAME="partitions_singleapp.csv"
CONFIG_LOG_DEFAULT_LEVEL_INFO=y
CONFIG_FREERTOS_HZ=1000
CONFIG_ESP_TASK_WDT=y
CONFIG_ESP_TASK_WDT_TIMEOUT_S=5
CONFIG_ESP_TASK_WDT_CHECK_IDLE_TASK_CPU0=y
CONFIG_ESP_TASK_WDT_CHECK_IDLE_TASK_CPU1=y
CONFIG_MQTT_PROTOCOL_311=y
CONFIG_MQTT_TRANSPORT_SSL=n
CONFIG_MQTT_TRANSPORT_WEBSOCKET=n
```

## TAREA 3/mqtt5/src/Kconfig.projbuild
```kconfig
menu "MQTT5 LED Config"

config EXAMPLE_WIFI_SSID
    string "WiFi SSID"
    default "Las Penas"

config EXAMPLE_WIFI_PASSWORD
    string "WiFi Password"
    default "Pena123321"

config BROKER_URL
    string "MQTT Broker URL"
    default "mqtt://broker.hivemq.com"

endmenu
```

## TAREA 4/KAKATACONTROL V2/firmware/sdkconfig.defaults
```kconfig
CONFIG_IDF_TARGET="esp32s3"
CONFIG_IDF_TARGET_ESP32S3=y
CONFIG_ESP32S3_DEFAULT_CPU_FREQ_240=y
CONFIG_ESP32S3_DEFAULT_CPU_FREQ_MHZ=240
CONFIG_ESPTOOLPY_FLASHSIZE_16MB=y
CONFIG_ESPTOOLPY_FLASHMODE_QIO=y
CONFIG_ESPTOOLPY_FLASHFREQ_80M=y
CONFIG_PARTITION_TABLE_CUSTOM=y
CONFIG_PARTITION_TABLE_CUSTOM_FILENAME="partitions.csv"
CONFIG_PARTITION_TABLE_FILENAME="partitions.csv"
CONFIG_PARTITION_TABLE_OFFSET=0x8000
CONFIG_FREERTOS_HZ=1000
CONFIG_LOG_DEFAULT_LEVEL_INFO=y
CONFIG_COMPILER_OPTIMIZATION_DEBUG=y
CONFIG_COMPILER_CXX_EXCEPTIONS=y
CONFIG_COMPILER_CXX_RTTI=y
CONFIG_SPI_FLASH_AUTO_SUSPEND=y
CONFIG_SPI_FLASH_ROM_DRIVER_PATCH=y
CONFIG_SPI_FLASH_DANGEROUS_WRITE_ABORTS=y
CONFIG_ESP_TASK_WDT=y
CONFIG_ESP_TASK_WDT_TIMEOUT_S=30
CONFIG_ESP_INT_WDT=y
CONFIG_ESP_INT_WDT_TIMEOUT_MS=300
CONFIG_ESP_PANIC_HANDLER_IRAM=y
CONFIG_APPTRACE_DEST_TRAX=y
CONFIG_APPTRACE_ONPANIC_HOST_FLUSH_TMO=30000
CONFIG_MBEDTLS_SSL_IN_CONTENT_LEN=16384
CONFIG_MBEDTLS_SSL_OUT_CONTENT_LEN=16384
CONFIG_LWIP_TCPIP_RECVMBOX_SIZE=32
CONFIG_LWIP_UDP_RECVMBOX_SIZE=6
CONFIG_LWIP_TCP_RECVMBOX_SIZE=32
CONFIG_LWIP_TCP_ACCEPTMBOX_SIZE=6
CONFIG_LWIP_TCP_MSL=60000
CONFIG_LWIP_TCP_SND_BUF_DEFAULT=5744
CONFIG_LWIP_TCP_WND_DEFAULT=5744
CONFIG_LWIP_TCP_RECVMBOX_SIZE=32
CONFIG_LWIP_UDP_RECVMBOX_SIZE=6
CONFIG_LWIP_TCP_ACCEPTMBOX_SIZE=6
CONFIG_LWIP_NETIF_STATUS_CALLBACK=y
CONFIG_LWIP_NETIF_LINK_CALLBACK=y
CONFIG_LWIP_IPV6=y
CONFIG_LWIP_IPV6_AUTOCONFIG=y
CONFIG_LWIP_IPV6_NUM_ADDRESSES=4
CONFIG_LWIP_NETIF_LOOPBACK=y
CONFIG_LWIP_LOOPBACK_MAX_PBUFS=8
CONFIG_LWIP_MAX_SOCKETS=10
CONFIG_LWIP_SO_LINGER=y
CONFIG_LWIP_SO_REUSE=y
CONFIG_LWIP_SO_REUSE_RXTOALL=y
CONFIG_LWIP_SO_RCVBUF=y
CONFIG_LWIP_TCP_KEEPALIVE=y
CONFIG_LWIP_TCP_KEEP_IDLE=120
CONFIG_LWIP_TCP_KEEP_INTVL=15
CONFIG_LWIP_TCP_KEEP_CNT=9
CONFIG_WIFI_PROV_SCAN_MAX_ENTRIES=16
CONFIG_WIFI_PROV_AUTOSTOP_TIMEOUT=30
CONFIG_ESP_WIFI_STATIC_RX_BUFFER_NUM=10
CONFIG_ESP_WIFI_DYNAMIC_RX_BUFFER_NUM=32
CONFIG_ESP_WIFI_TX_BUFFER_TYPE_DYNAMIC=y
CONFIG_ESP_WIFI_DYNAMIC_TX_BUFFER_NUM=32
CONFIG_ESP_WIFI_CSI_ENABLED=y
CONFIG_ESP_WIFI_AMPDU_RX_ENABLED=y
CONFIG_ESP_WIFI_AMPDU_TX_ENABLED=y
CONFIG_ESP_WIFI_AMSDU_TX_ENABLED=y
CONFIG_ESP_WIFI_NVS_ENABLED=y
CONFIG_ESP_WIFI_TASK_PINNED_TO_CORE_0=y
CONFIG_ESP_WIFI_SOFTAP_BEACON_MAX_LEN=752
CONFIG_ESP_WIFI_MGMT_SBUF_NUM=32
CONFIG_ESP_WIFI_IRAM_OPT=y
CONFIG_ESP_WIFI_RX_IRAM_OPT=y
CONFIG_ESP_WIFI_ENABLE_WPA3_SAE=y
CONFIG_ESP_WIFI_SOFTAP_SAE_SUPPORT=y
CONFIG_ESP_WIFI_ENTERPRISE=y
CONFIG_ESP_WIFI_MBEDTLS_TLS_CLIENT=y
CONFIG_ESP_WIFI_MBEDTLS_TLS_SERVER=y
CONFIG_ESP_WIFI_WPS=y
CONFIG_ESP_WIFI_WPS_STRICT=y
CONFIG_ESP_WIFI_DEBUG_LOG_DEFAULT=y
CONFIG_BT_ENABLED=y
CONFIG_BT_CONTROLLER_MODE_BLE=y
CONFIG_BT_CONTROLLER_MODE_BTDM=y
CONFIG_BTDM_CONTROLLER_HCI_MODE_VHCI=y
CONFIG_BTDM_CONTROLLER_MODE_BLE_ONLY=y
CONFIG_BTDM_CTRL_BLE_MAX_CONN=3
CONFIG_BTDM_CTRL_BR_MAX_ACL_CONN=3
CONFIG_BTDM_CTRL_BR_MAX_SYNC_CONN=2
CONFIG_BT_HCI_UART_NO=y
CONFIG_BT_HID_HOST_ENABLED=y
CONFIG_BT_A2DP_ENABLED=y
CONFIG_BT_AVDT_ENABLED=y
CONFIG_BT_AVRCP_ENABLED=y
CONFIG_BT_SDP_ENABLED=y
CONFIG_BT_RFCOMM_ENABLED=y
CONFIG_BT_GATTC_ENABLED=y
CONFIG_BT_GATTS_ENABLED=y
CONFIG_BT_GATT_MAX_SR_PROFILES=8
CONFIG_BT_GATT_MAX_CLIENTS=3
CONFIG_BT_BLE_ENABLED=y
CONFIG_BT_NIMBLE_ENABLED=y
CONFIG_BT_NIMBLE_MAX_CONNECTIONS=3
CONFIG_BT_NIMBLE_MAX_BONDS=3
CONFIG_BT_NIMBLE_MAX_CCCDS=8
CONFIG_BT_NIMBLE_L2CAP_COC_MAX_NUM=3
CONFIG_BT_NIMBLE_PINNED_TO_CORE_0=y
CONFIG_BT_NIMBLE_TASK_STACK_SIZE=5120
CONFIG_BT_NIMBLE_ROLE_CENTRAL=y
CONFIG_BT_NIMBLE_ROLE_PERIPHERAL=y
CONFIG_BT_NIMBLE_ROLE_BROADCASTER=y
CONFIG_BT_NIMBLE_ROLE_OBSERVER=y
CONFIG_BT_NIMBLE_MESH=y
CONFIG_BT_NIMBLE_MESH_PROV=y
CONFIG_BT_NIMBLE_MESH_PROXY=y
CONFIG_BT_NIMBLE_MESH_RELAY=y
CONFIG_BT_NIMBLE_MESH_LOW_POWER=y
CONFIG_BT_NIMBLE_MESH_FRIEND=y
CONFIG_BT_NIMBLE_MESH_GATT_PROXY=y
CONFIG_BT_NIMBLE_MESH_PROVISIONER=y
CONFIG_BT_NIMBLE_MESH_NODE=y
CONFIG_BT_NIMBLE_MESH_FRIEND_NODE=y
CONFIG_BT_NIMBLE_MESH_LOW_POWER_NODE=y
CONFIG_BT_NIMBLE_MESH_RELAY_NODE=y
CONFIG_BT_NIMBLE_MESH_PROXY_NODE=y
CONFIG_BT_NIMBLE_MESH_PROVISIONER_NODE=y
CONFIG_BT_NIMBLE_MESH_NODE_IDENTITY_TIMEOUT=60
CONFIG_BT_NIMBLE_MESH_NET_BUF_POOL_SIZE=20
CONFIG_BT_NIMBLE_MESH_PROV_BUF_POOL_SIZE=5
CONFIG_BT_NIMBLE_MESH_IVU_DIVIDER=10
CONFIG_BT_NIMBLE_MESH_SEQ_STORE_RATE=100
CONFIG_BT_NIMBLE_MESH_RPL_SIZE=10
CONFIG_BT_NIMBLE_MESH_MSG_CACHE_SIZE=10
CONFIG_BT_NIMBLE_MESH_ADV_BUF_COUNT=60
CONFIG_BT_NIMBLE_MESH_IVU_DIVIDER=10
CONFIG_BT_NIMBLE_MESH_NODE_IDENTITY_TIMEOUT=60
CONFIG_BT_NIMBLE_MESH_SEQ_STORE_RATE=100
CONFIG_BT_NIMBLE_MESH_RPL_SIZE=10
CONFIG_BT_NIMBLE_MESH_MSG_CACHE_SIZE=10
CONFIG_BT_NIMBLE_MESH_ADV_BUF_COUNT=60
```

## TAREA 5/KAKATA_CONTROLR_433 V2/sdkconfig.defaults
```kconfig
CONFIG_IDF_TARGET="esp32s3"
CONFIG_IDF_TARGET_ESP32S3=y
CONFIG_ESP32S3_DEFAULT_CPU_FREQ_240=y
CONFIG_ESP32S3_DEFAULT_CPU_FREQ_MHZ=240
CONFIG_ESPTOOLPY_FLASHSIZE_16MB=y
CONFIG_ESPTOOLPY_FLASHMODE_QIO=y
CONFIG_ESPTOOLPY_FLASHFREQ_80M=y
CONFIG_PARTITION_TABLE_CUSTOM=y
CONFIG_PARTITION_TABLE_CUSTOM_FILENAME="partitions.csv"
CONFIG_PARTITION_TABLE_FILENAME="partitions.csv"
CONFIG_PARTITION_TABLE_OFFSET=0x8000
CONFIG_FREERTOS_HZ=1000
CONFIG_LOG_DEFAULT_LEVEL_INFO=y
CONFIG_COMPILER_OPTIMIZATION_DEBUG=y
CONFIG_COMPILER_CXX_EXCEPTIONS=y
CONFIG_COMPILER_CXX_RTTI=y
CONFIG_SPI_FLASH_AUTO_SUSPEND=y
CONFIG_SPI_FLASH_ROM_DRIVER_PATCH=y
CONFIG_SPI_FLASH_DANGEROUS_WRITE_ABORTS=y
CONFIG_ESP_TASK_WDT=y
CONFIG_ESP_TASK_WDT_TIMEOUT_S=30
CONFIG_ESP_INT_WDT=y
CONFIG_ESP_INT_WDT_TIMEOUT_MS=300
CONFIG_ESP_PANIC_HANDLER_IRAM=y
CONFIG_MQTT_PROTOCOL_311=y
CONFIG_MQTT_TRANSPORT_SSL=y
CONFIG_MQTT_TRANSPORT_WEBSOCKET=y
```

## TAREA 6/PORTON V2/sdkconfig.defaults
```kconfig
CONFIG_IDF_TARGET="esp32"
CONFIG_ESPTOOLPY_FLASHSIZE_4MB=y
CONFIG_ESPTOOLPY_FLASHMODE_QIO=y
CONFIG_ESPTOOLPY_FLASHFREQ_80M=y
CONFIG_PARTITION_TABLE_SINGLE_APP=y
CONFIG_FREERTOS_HZ=1000
CONFIG_LOG_DEFAULT_LEVEL_INFO=y
CONFIG_COMPILER_OPTIMIZATION_DEBUG=y
CONFIG_COMPILER_CXX_EXCEPTIONS=y
CONFIG_COMPILER_CXX_RTTI=y
CONFIG_ESP_TASK_WDT=y
CONFIG_ESP_TASK_WDT_TIMEOUT_S=30
CONFIG_ESP_INT_WDT=y
CONFIG_ESP_INT_WDT_TIMEOUT_MS=300
CONFIG_ESP_PANIC_HANDLER_IRAM=y
CONFIG_MQTT_PROTOCOL_311=y
CONFIG_MQTT_TRANSPORT_SSL=y
CONFIG_MQTT_TRANSPORT_WEBSOCKET=y
```

## TAREA 6/PORTON/sdkconfig.defaults
```kconfig
CONFIG_ESP_MAIN_TASK_STACK_SIZE=8192
CONFIG_FREERTOS_HZ=1000
CONFIG_LOG_DEFAULT_LEVEL_INFO=y
CONFIG_MQTT_PROTOCOL_5=y
```

## TAREA 8/JUEGO DE RAPIDEZ 2 MODOS V2/sdkconfig.defaults
```kconfig
CONFIG_ESPTOOLPY_MONITOR_BAUD=115200
CONFIG_PARTITION_TABLE_SINGLE_APP=y
CONFIG_PARTITION_TABLE="single_app.csv"
CONFIG_LOG_DEFAULT_LEVEL_INFO=y
CONFIG_MBEDTLS_TLS_CLIENT=y
CONFIG_MQTT_PROTOCOL_311=y
CONFIG_MQTT_TRANSPORT_SSL=y
CONFIG_MQTT_TRANSPORT_WEBSOCKET=y
```
